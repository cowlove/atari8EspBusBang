## components/i2slink/examples/pingpong/main/Kconfig.projbuild
```kconfig
menu "i2slink ping-pong"

    choice PINGPONG_ROLE
        prompt "This board's role"
        default PINGPONG_ROLE_LOOPBACK
        help
            PING drives the link clock (BCLK), sends pings and measures the
            round trips. PONG follows the clock and echoes every ping back.
            LOOPBACK needs one board and no wires: the link's RX listens on
            its own TX pin, so each ping comes back as itself (the link's
            one-way pipeline, not a round trip).

        config PINGPONG_ROLE_PING
            bool "PING (clock source)"
        config PINGPONG_ROLE_PONG
            bool "PONG (clock follower, echoes)"
        config PINGPONG_ROLE_LOOPBACK
            bool "LOOPBACK (one board, no wiring)"
    endchoice

    config PINGPONG_BCLK_GPIO
        int "BCLK GPIO (PING/LOOPBACK: output; PONG: input)"
        range 0 48
        default 4

    config PINGPONG_TX_GPIO
        int "TX data GPIO (to the peer's RX)"
        range 0 48
        default 5

    config PINGPONG_RX_GPIO
        int "RX data GPIO (from the peer's TX; unused in LOOPBACK)"
        range 0 48
        default 6

    config PINGPONG_BULK_BYTES
        int "Payload bytes in the bulk phase (up to the link's payload, 292 by default)"
        range 16 1700
        default 292

endmenu
```

## main/Kconfig.projbuild
```kconfig
menu "Atari 8-bit Bus"

config A8BB_SYSMONITOR
    bool "System monitor (console-key configuration menu)"
    default n
    help
        The configuration menu the PBI driver shows (main/sysMonitor.cpp),
        entered by holding a console key at boot, the 0xE5 key code, or
        every N seconds (config.sysMonitorSec). Its code and data are in
        internal RAM so it can run while core 1 drives the bus: about 6.5 KB
        of static internal RAM plus its menu items on the internal heap.
        Off: none of that is built, and the monitor never starts.

config A8BB_CORE0_HOTSPOTS_EXPLICIT_PLACEMENT
    bool "Explicitly place Core0 IRAM hotspots"
    default n
    help
        Put the Core0 hotspot functions together and align iloop_pbi to the
        next 32 KiB boundary. This guarantees separation from the Core1 loop,
        at the cost of additional IRAM address space and reduced heap space.
        Not with the Sidecar (-DSIDECAR=ON): ldgen orders IRAM code by archive name,
        so libi2slink's hotspots land after the alignment, in the
        Core1 loop's bank, and the post-link check fails the build.

config A8BB_WIFI
    bool "WiFi on main (for its own SMB mounts)"
    default n
    help
        Main's own WiFi station (main/wifi.cpp, wifiPreinit() at boot), for
        the boot profile's smb: drives on a board without a Sidecar. The
        web server, telnet and mDNS are the Sidecar's only (2026-11-21:
        sidecar/main/sidecarNet.cpp; main's telnet is the screen half,
        telnetScreen.cpp, over the link). Off, the linker drops the WiFi
        driver and the PHY blob, whose IRAM (libphy ~5 KB, libpp ~1 KB on
        the S3) no setting moves to flash, and smb: drives stay empty.

config A8BB_REFRESH_GPIO
    int
    default 21
    help
        Where the Atari's refresh_ (active low) reaches main: GPIO21 on
        every board, with or without the Sidecar (its link RX is GPIO18).
        19 (main's USB D-) was the Sidecar builds' while the link RX was
        GPIO21; main's USB-Serial-JTAG pad is then turned off at boot.
        Must be in GPIO_IN_REG (0-31): core 1 tests it in r0. 0: no
        refresh_ (core 1 records refresh cycles, core 0 drops none). No
        prompt (a saved int would keep its old value).

endmenu
```
