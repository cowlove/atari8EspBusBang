## main/Kconfig.projbuild
```kconfig
menu "Atari 8-bit Bus"

config A8BB_ENABLE_MDNS
    bool "Enable mDNS hostname support"
    default n
    help
        Link mDNS support and advertise a MAC-derived hostname on the local
        network. The boot profile must also enable mDNS at runtime.

config A8BB_SYSMONITOR
    bool "System monitor (console-key configuration menu)"
    default y
    help
        The configuration menu the PBI driver shows (main/sysMonitor.cpp),
        entered by holding a console key at boot, the 0xE5 key code, or
        every N seconds (config.sysMonitorSec). Its code and data are in
        internal RAM so it can run while core 1 drives the bus: about 6.5 KB
        of static internal RAM plus its menu items on the internal heap.
        Off: none of that is built, and the monitor never starts.

config A8BB_CORE0_HOTSPOTS_EXPLICIT_PLACEMENT
    bool "Explicitly place Core0 IRAM hotspots"
    default n
    help
        Put the Core0 hotspot functions together and align iloop_pbi to the
        next 32 KiB boundary. This guarantees separation from the Core1 loop,
        at the cost of additional IRAM address space and reduced heap space.
        Not with A8BB_SIDECAR_ENABLE: ldgen orders IRAM code by archive name,
        so libsidecar_link's hotspots land after the alignment, in the
        Core1 loop's bank, and the post-link check fails the build.

config A8BB_SIDECAR_ENABLE
    bool "Use the Sidecar coprocessor"
    default n
    help
        Have the host use the Sidecar, an optional second ESP32 coprocessor
        (the app in sidecar/), over the i2slink I2S DMA link. The link and
        protocol live in components/sidecar_link and are always compiled;
        this gates the host code that uses them. The link speed is
        I2SLINK_FRAMES_PER_SECOND in i2slink.h and must match on both ends.
        Incompatible with PROFILE_MODE=PIN (core 1 drives GPIO48, the link's
        BCLK); the build stops if both are selected. PROFILE_MODE=GPIO only
        samples pins and works. Also turns off the status LED.

config A8BB_SIDECAR_LOOPBACK
    bool "Loop the Sidecar link back on the host (no Sidecar)"
    depends on A8BB_SIDECAR_ENABLE
    default n
    help
        Test mode: the host's link receives its own transmissions. TX and RX
        share the TX pin (GPIO0), so the Sidecar's RX pin (GPIO21, the Atari
        refresh_ input) is left alone; the host drives BCLK (GPIO48) as it
        always does. Every Sidecar call (probe(), nop(), sio(), cio()) gets
        its own command back as the response, through the normal transact()
        path, and Sidecar::loopbackCheck() also checks the echo byte for
        byte. Runs on a bare host board. A wired Sidecar can stay connected
        (it drives only its own TX wire, which the host then ignores), but
        it still receives and executes the host's commands, so mind
        commands with side effects.

endmenu
```
